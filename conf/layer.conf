## conf/layer.conf
```bitbake
# We have a conf and classes directory, add to BBPATH
BBPATH .= ":${LAYERDIR}"

# We have recipes-* directories, add to BBFILES
BBFILES += "${LAYERDIR}/recipes-*/*/*.bb \
            ${LAYERDIR}/recipes-*/*/*.bbappend"

BBFILE_COLLECTIONS += "meta-alliedvision-xlnx"
BBFILE_PATTERN_meta-alliedvision-xlnx = "^${LAYERDIR}/"
BBFILE_PRIORITY_meta-alliedvision-xlnx = "6"

LAYERDEPENDS_meta-alliedvision-xlnx = "core alliedvision xilinx xilinx-mali400"
LAYERSERIES_COMPAT_meta-alliedvision-xlnx = "scarthgap"
```
